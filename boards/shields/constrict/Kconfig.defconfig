## boards/shields/constrict/Kconfig.defconfig
```kconfig
if SHIELD_CONSTRICT_LEFT

config ZMK_KEYBOARD_NAME
    default "Constrict"

config ZMK_SPLIT_ROLE_CENTRAL
    default y

endif # SHIELD_CONSTRICT_LEFT

if SHIELD_CONSTRICT_LEFT || SHIELD_CONSTRICT_RIGHT

config ZMK_SPLIT
    default y

endif # SHIELD_CONSTRICT_LEFT || SHIELD_CONSTRICT_RIGHT
```

## boards/shields/constrict/Kconfig.shield
```kconfig
config SHIELD_CONSTRICT_LEFT
    def_bool $(shields_list_contains,constrict_left)

config SHIELD_CONSTRICT_RIGHT
    def_bool $(shields_list_contains,constrict_right)
```
